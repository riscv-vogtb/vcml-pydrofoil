## sw/zephyr/boards/vcml/pydrofoil_32/Kconfig.pydrofoil_32
```kconfig
# SPDX-License-Identifier: Apache-2.0

config BOARD_PYDROFOIL_32
	select SOC_QEMU_VIRT_RISCV32
```

## sw/zephyr/boards/vcml/pydrofoil_32/board.yml
```yaml
board:
  name: pydrofoil_32
  full_name: Pydrofoil 32-bit Virtual Prototype
  vendor: vcml
  socs:
    - name: qemu_virt_riscv32
```

## sw/zephyr/boards/vcml/pydrofoil_64/Kconfig.pydrofoil_64
```kconfig
# SPDX-License-Identifier: Apache-2.0

config BOARD_PYDROFOIL_64
	select SOC_QEMU_VIRT_RISCV64
```

## sw/zephyr/boards/vcml/pydrofoil_64/board.yml
```yaml
board:
  name: pydrofoil_64
  full_name: Pydrofoil 64-bit Virtual Prototype
  vendor: vcml
  socs:
    - name: qemu_virt_riscv64
```

## sw/zephyr/drivers/Kconfig
```kconfig
# SPDX-License-Identifier: Apache-2.0

config UART_PYDROFOIL
	bool "Pydrofoil VP UART driver"
	default y
	depends on SERIAL
	depends on DT_HAS_VCML_NRF51_UART_ENABLED
	select SERIAL_HAS_DRIVER
	help
	  Polling UART driver for the vcml::serial::nrf51 model instantiated
	  by the vcml-pydrofoil virtual platform at 0x10009000.

	  The model transmits synchronously on a TXD write, so this driver
	  implements poll_in/poll_out only.
```

## sw/zephyr/drivers/dts/bindings/serial/vcml,nrf51-uart.yaml
```yaml
# SPDX-License-Identifier: Apache-2.0

description: |
  UART of the vcml::serial::nrf51 model as instantiated by the vcml-pydrofoil
  virtual platform. Register layout follows the nRF51 UART (task/event
  registers plus ENABLE/RXD/TXD), but the peripheral is memory mapped at an
  address chosen by the VP rather than by a Nordic SoC.

compatible: "vcml,nrf51-uart"

include: uart-controller.yaml

properties:
  reg:
    required: true

  interrupts:
    required: false
```

## sw/zephyr/lib/Kconfig
```kconfig
# SPDX-License-Identifier: Apache-2.0

config VP_FAULT_REPORT
	bool "Classify and report faults on the vcml-pydrofoil VP"
	default y
	help
	  Installs a k_sys_fatal_error_handler that tells a poison hit from an
	  ordinary fault and ends the run through the VP's simdev with a
	  distinguishing exit code.

	  Turn this off to supply your own handler; the two cannot coexist.
```
