## CMakeLists.txt
```
# SPDX-License-Identifier: Apache-2.0

cmake_minimum_required(VERSION 3.20.0)
find_package(Zephyr REQUIRED HINTS $ENV{ZEPHYR_BASE})
project(mpoison_minimal)

target_sources(app PRIVATE src/main.c)
target_compile_options(app PRIVATE -mllvm -riscv-stack-poison)
```

## prj.conf
```kconfig
# -O0 and TLS handling for the llvm toolchain are set globally in build.sh.
```

## src/main.c
```c
#include <stdio.h>

static int trigger(void)
{
	int buf[16];
	buf[0] = 1;
	return buf[1];
}

int main(void)
{
	printf("calling trigger()...\n");
	int result = trigger();
	printf("trigger() returned %d\n", result);
	return 0;
}
```
