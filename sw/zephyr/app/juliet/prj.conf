## CMakeLists.txt
```
# SPDX-License-Identifier: Apache-2.0

cmake_minimum_required(VERSION 3.20.0)

find_package(Zephyr REQUIRED HINTS $ENV{ZEPHYR_BASE})
project(juliet)

# Point to the "C" folder from juliet
# If env isnt set, we assume it to live under "juliet_test_suite" in vcml base
if(DEFINED ENV{JULIET_ROOT})
  set(JULIET_ROOT $ENV{JULIET_ROOT})
else()
  set(JULIET_ROOT ${CMAKE_CURRENT_SOURCE_DIR}/../../../../juliet_test_suite)
endif()

# The testcase is pulled in by juliet_case.c, which tools/juliet regenerates
# per test. It lives in the build directory, so a suite run never touches the
# source tree; src/case_default.c seeds it for a standalone build.
set(JULIET_CASE_C ${CMAKE_CURRENT_BINARY_DIR}/juliet_case.c)
if(NOT EXISTS ${JULIET_CASE_C})
  configure_file(src/case_default.c ${JULIET_CASE_C} COPYONLY)
endif()

# This source list stays constant across testcases, so CMake never re-runs.
target_sources(app PRIVATE
  src/main.c
  ${JULIET_CASE_C}
  ${JULIET_ROOT}/testcasesupport/io.c
)
target_include_directories(app PRIVATE
  ${JULIET_ROOT}/testcasesupport
  ${JULIET_ROOT}/testcases
)
target_compile_options(app PRIVATE -mllvm -riscv-stack-poison)
# picolibc does not declare alloca, which the alloca testcases go through.
target_compile_definitions(app PRIVATE alloca=__builtin_alloca)
```

## prj.conf
```kconfig
# Board defconfig already carries the VP quirks (no tick source, no PMP).
# The malloc testcase categories will need a libc heap arena here.

# The buffer testcases put several 100-element arrays in one frame.
CONFIG_MAIN_STACK_SIZE=4096
```

## src/main.c
```c
/*
 * SPDX-License-Identifier: Apache-2.0
 *
 * Driver for one Juliet testcase. juliet_case.c, generated into the build
 * directory, names the case and runs either its good() or its bad() half --
 * one per elf, so neither can hide a fault in the other.
 */

#include <stdio.h>

#include <vp/sim.h>

extern const char *juliet_case_name;
extern const char *juliet_phase;
extern void juliet_run(void);

int main(void)
{
	printf("VP-TEST: %s\n", juliet_case_name);

	printf("VP-PHASE: %s\n", juliet_phase);
	juliet_run();

	/* Reached only when nothing faulted; ends the run instead of idling. */
	printf("VP-PHASE: done\n");
	vp_sim_exit(VP_EXIT_OK);

	return 0;
}
```

## src/case_default.c
```c
// Fallback testcase, used when tools/juliet has not generated one into the build directory.
#include "CWE457_Use_of_Uninitialized_Variable/s01/CWE457_Use_of_Uninitialized_Variable__int_array_declare_no_init_01.c"

const char *juliet_case_name = "int_array_declare_no_init_01";
const char *juliet_phase = "bad";

void juliet_run(void)
{
	CWE457_Use_of_Uninitialized_Variable__int_array_declare_no_init_01_bad();
}
```
